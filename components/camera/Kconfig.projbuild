## components/camera/Kconfig.projbuild
```kconfig
menu "Example Configuration"

config ENABLE_TEST_PATTERN
	bool "Enable test pattern on camera output"
	default n
	help
		Configure the camera module to output test pattern instead of live image.
		
		Use this option to troubleshoot image issues like noise,
		distortion, not legible and missing live image.
		Instead, module will generate regular vertical bars 
		in shades from dark to white.
	
endmenu
```

## main/Kconfig.projbuild
```kconfig
menu "ESP32 Camera Demo Configuration"

config WIFI_SSID
    string "WiFi SSID"
    default ""
    help
        SSID (network name) for the demo to connect to.

config WIFI_PASSWORD
    string "WiFi Password"
    default ""
    help
        Password for your network.

endmenu
```
